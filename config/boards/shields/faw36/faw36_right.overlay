// faw36_right.overlay

#include "faw36.dtsi" // Notice that the main dtsi files are included in the overlay.

&default_transform {
	col-offset = <2>;
};

&kscan0 {
    col-gpios
			= <&expander 0 (GPIO_ACTIVE_HIGH)>
			, <&expander 1 (GPIO_ACTIVE_HIGH)>
			;
};
