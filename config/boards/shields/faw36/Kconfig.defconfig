## config/boards/shields/faw36/Kconfig.defconfig
```kconfig
# Copyright (c) 2020 The ZMK Contributors
# SPDX-License-Identifier: MIT

if SHIELD_FAW36_RIGHT

config ZMK_KEYBOARD_NAME
	default "faw36"

config ZMK_SPLIT_ROLE_CENTRAL
	default y

endif

if SHIELD_FAW36_LEFT || SHIELD_FAW36_RIGHT

config ZMK_SPLIT
	default y

endif

config I2C
	default y

config GPIO_MCP23017
	default y
```

## config/west.yml
```yaml
manifest:
  remotes:
    - name: zmkfirmware
      url-base: https://github.com/drorchen
  projects:
    - name: zmk
      remote: zmkfirmware
      revision: dracula-test
      import: app/west.yml
  self:
    path: config
```
