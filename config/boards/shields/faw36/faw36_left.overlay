// faw36_left.overlay

#include "faw36.dtsi" // Notice that the main dtsi files are included in the overlay.

&kscan0 {
    col-gpios
			= <&expander 2 (GPIO_ACTIVE_HIGH)>
			, <&expander 3 (GPIO_ACTIVE_HIGH)>
			;
};

